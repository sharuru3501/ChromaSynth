; Minimal DMG/CGB hardware register definitions (only what we use).
IF !DEF(HARDWARE_INC)
DEF HARDWARE_INC EQU 1

DEF rP1   EQU $FF00
DEF rSB   EQU $FF01
DEF rSC   EQU $FF02
DEF rIF   EQU $FF0F

DEF rNR10 EQU $FF10
DEF rNR11 EQU $FF11
DEF rNR12 EQU $FF12
DEF rNR13 EQU $FF13
DEF rNR14 EQU $FF14
DEF rNR21 EQU $FF16
DEF rNR22 EQU $FF17
DEF rNR23 EQU $FF18
DEF rNR24 EQU $FF19
DEF rNR30 EQU $FF1A
DEF rNR31 EQU $FF1B
DEF rNR32 EQU $FF1C
DEF rNR33 EQU $FF1D
DEF rNR34 EQU $FF1E
DEF rNR41 EQU $FF20
DEF rNR42 EQU $FF21
DEF rNR43 EQU $FF22
DEF rNR44 EQU $FF23
DEF rNR50 EQU $FF24
DEF rNR51 EQU $FF25
DEF rNR52 EQU $FF26
DEF _AUD3WAVERAM EQU $FF30

DEF rLCDC EQU $FF40
DEF rSTAT EQU $FF41
DEF rSCY  EQU $FF42
DEF rSCX  EQU $FF43
DEF rLY   EQU $FF44
DEF rBGP  EQU $FF47
DEF rBCPS EQU $FF68 ; CGB background palette index
DEF rBCPD EQU $FF69 ; CGB background palette data
DEF rIE   EQU $FFFF

DEF _VRAM   EQU $8000
DEF _SCRN0  EQU $9800

; IF / IE bits
DEF IEF_VBLANK EQU %00000001
DEF IEF_SERIAL EQU %00001000

; LCDC
DEF LCDCF_ON     EQU %10000000
DEF LCDCF_BGON   EQU %00000001
DEF LCDCF_BLK01  EQU %00010000 ; BG tile data at $8000

; Joypad bits as returned by ReadJoy (1 = pressed)
DEF PADB_A      EQU 0
DEF PADB_B      EQU 1
DEF PADB_SELECT EQU 2
DEF PADB_START  EQU 3
DEF PADB_RIGHT  EQU 4
DEF PADB_LEFT   EQU 5
DEF PADB_UP     EQU 6
DEF PADB_DOWN   EQU 7

ENDC
